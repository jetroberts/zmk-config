## config/boards/shields/ergotype/Kconfig.defconfig
```kconfig
if SHIELD_ERGOTYPE_LEFT

config ZMK_KEYBOARD_NAME
    default "ergotype"

config ZMK_SPLIT_ROLE_CENTRAL
    default y

endif

if SHIELD_ERGOTYPE_LEFT || SHIELD_ERGOTYPE_RIGHT

config ZMK_SPLIT
    default y

endif
```

## config/boards/shields/ergotype/Kconfig.shield
```kconfig
config SHIELD_ERGOTYPE_LEFT
    def_bool $(shields_list_contains, ergotype_left)

config SHIELD_ERGOTYPE_RIGHT
    def_bool $(shields_list_contains, ergotype_right)
    
```
